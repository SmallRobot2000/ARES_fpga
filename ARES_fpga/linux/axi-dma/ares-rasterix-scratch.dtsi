/* Dedicated diagnostic memory, inside RasterIX's 128 MiB AXI window.
 * Excluded from Linux RAM/CMA. Do not use as an active framebuffer while testing.
 */
&{/reserved-memory} {
    rasterix_scratch: rasterix-scratch@97f00000 {
        reg = <0x97f00000 0x00100000>;
        no-map;
        status = "okay";
    };
};
