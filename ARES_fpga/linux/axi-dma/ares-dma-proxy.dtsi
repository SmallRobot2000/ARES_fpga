/* OPTIONAL: build/load ../dma-proxy/ares_dma_proxy.ko for this client.
 * Include after ares-axi-dma.dtsi.
 * Adding this node alone does not create /dev/dma_proxy_*.
 */
/ {
    dma_proxy {
        compatible = "xlnx,dma_proxy";
        dmas = <&axi_dma_0 0>, <&axi_dma_0 1>;
        dma-names = "dma_proxy_tx", "dma_proxy_rx";
        dma-coherent;
        status = "okay";
    };
};
